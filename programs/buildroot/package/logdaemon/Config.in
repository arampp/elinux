## programs/buildroot/package/logdaemon/Config.in
```kconfig
config BR2_PACKAGE_LOGDAEMON 
       bool "Logdaemon"
       default n
       help
       This is a daemon which observes a character device and logs if the state
       changes.
```
